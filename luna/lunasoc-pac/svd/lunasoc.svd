# lunasoc register map
Vendor: amaranth-soc
TODO device.description
Registers are 32-bit, read-write, reset 0x0 unless marked. A register's access mark holds for its fields unless they carry their own. Offsets are from the block's base; lines under a group give offsets from that group; [hi:lo] are bit positions; {n}, {i} and the like mark numbered series; 'fields as' and 'values as' point back to an identical list; <NAME> marks a mode.

## Memory map
0x80000000 UART size 0x40
0x80000040 GPIOA size 0x20
0x80000060 GPIOB size 0x20
0x80000080 LEDS size 0x8
0x80001000 TIMER size 0x20
0x80002000 USB0 size 0x40
0x80002040 USB0_EP_CONTROL size 0x40
0x80002080 USB0_EP_IN size 0x40
0x80002100 USB0_EP_OUT size 0x80
0x80003000 USB1 size 0x40
0x80003040 USB1_EP_CONTROL size 0x40
0x80003080 USB1_EP_IN size 0x40
0x80003100 USB1_EP_OUT size 0x80
0x80004000 USB2 size 0x40
0x80004040 USB2_EP_CONTROL size 0x40
0x80004080 USB2_EP_IN size 0x40
0x80004100 USB2_EP_OUT size 0x80

## Interrupts
0 timer (TIMER)
1 uart (UART)
2 gpioa (GPIOA)
3 gpiob (GPIOB)
4 usb0 (USB0)
5 usb0_ep_control (USB0_EP_CONTROL)
6 usb0_ep_in (USB0_EP_IN)
7 usb0_ep_out (USB0_EP_OUT)
8 usb1 (USB1)
9 usb1_ep_control (USB1_EP_CONTROL)
10 usb1_ep_in (USB1_EP_IN)
11 usb1_ep_out (USB1_EP_OUT)
12 usb2 (USB2)
13 usb2_ep_control (USB2_EP_CONTROL)
14 usb2_ep_in (USB2_EP_IN)
15 usb2_ep_out (USB2_EP_OUT)

## Further device data
memoryRegions:
  BOOTROM baseAddress=0x00000000 size=0x00004000
  SCRATCHPAD baseAddress=0x00004000 size=0x00001000
  INTERNAL_SRAM baseAddress=0x40000000 size=0x00010000

## TIMER
Base 0x80001000
0x00 reload — timer reload register
  [31:0] reload — timer reload register field
0x04 en — timer en register
  [0] en — timer en register field
0x08 ctr — timer ctr register
  [31:0] ctr — timer ctr register field
0x10 ev_status ro — timer ev_status register
  [0] status — timer status register field
0x14 ev_pending — timer ev_pending register
  [0] pending — timer pending register field
0x18 ev_enable — timer ev_enable register
  [0] enable — timer enable register field

## UART
Base 0x80000000
0x00 divisor — uart divisor register
  [9:0] divisor — uart divisor register field
0x04 rx_data ro — uart rx_data register
  [7:0] rx_data — uart rx_data register field
0x08 rx_rdy ro — uart rx_rdy register
  [0] rx_rdy — uart rx_rdy register field
0x0C rx_err ro — uart rx_err register
  [2:0] rx_err — uart rx_err register field
0x10 tx_data wo — uart tx_data register
  [7:0] tx_data — uart tx_data register field
0x14 tx_rdy ro — uart tx_rdy register
  [0] tx_rdy — uart tx_rdy register field
0x20 ev_status ro — uart ev_status register
  [2:0] status — uart status register field
0x24 ev_pending — uart ev_pending register
  [2:0] pending — uart pending register field
0x28 ev_enable — uart ev_enable register
  [2:0] enable — uart enable register field

## GPIOA
Base 0x80000040
0x00 moder — gpioa moder register
  [7:0] moder — gpioa moder register field
0x04 odr wo — gpioa odr register
  [7:0] odr — gpioa odr register field
0x08 idr ro — gpioa idr register
  [7:0] idr — gpioa idr register field
0x10 ev_status ro — gpioa ev_status register
  [0] status — gpioa status register field
0x14 ev_pending — gpioa ev_pending register
  [0] pending — gpioa pending register field
0x18 ev_enable — gpioa ev_enable register
  [0] enable — gpioa enable register field

## GPIOB
Base 0x80000060
0x00 moder — gpiob moder register
  [7:0] moder — gpiob moder register field
0x04 odr wo — gpiob odr register
  [7:0] odr — gpiob odr register field
0x08 idr ro — gpiob idr register
  [7:0] idr — gpiob idr register field
0x10 ev_status ro — gpiob ev_status register
  [0] status — gpiob status register field
0x14 ev_pending — gpiob ev_pending register
  [0] pending — gpiob pending register field
0x18 ev_enable — gpiob ev_enable register
  [0] enable — gpiob enable register field

## LEDS
Base 0x80000080
0x00 output wo — leds output register
  [5:0] output — leds output register field
