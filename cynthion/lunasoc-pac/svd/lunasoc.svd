# lunasoc register map
Vendor: amaranth-soc
Registers are 32-bit, read-write, reset 0x0 unless marked. A register's access mark holds for its fields unless they carry their own. Offsets are from the block's base; [hi:lo] are bit positions.

## USB2
Base 0xF0005000
0x00 connect — usb2 connect register
  [0] connect — Set this bit to '1' to allow the associated USB device to connect to a host.
0x04 speed ro — usb2 speed register
  [1:0] speed — Indicates the current speed of the USB device. 0 indicates High; 1 => Full, 2 => Low, and 3 => SuperSpeed (incl SuperSpeed+).
0x10 ev_status ro — usb2 ev_status register
  [0] status — usb2 status register field
0x14 ev_pending — usb2 ev_pending register
  [0] pending — usb2 pending register field
0x18 ev_enable — usb2 ev_enable register
  [0] enable — usb2 enable register field

## USB2_EP_CONTROL
Base 0xF0005040
0x00 data ro — usb2_ep_control data register
  [7:0] data — A FIFO that returns the bytes from the most recently captured SETUP packet. Reading a byte from this register advances the FIFO. The first eight bytes read from this conain the core SETUP packet.
0x04 reset wo — usb2_ep_control reset register
  [0] reset — Local reset control for the SETUP handler; writing a '1' to this register clears the handler state.
0x08 epno ro — usb2_ep_control epno register
  [3:0] epno — The number of the endpoint associated with the current SETUP packet.
0x0C have ro — usb2_ep_control have register
  [0] have — `1` iff data is available in the FIFO.
0x10 pend ro — usb2_ep_control pend register
  [0] pend — `1` iff an interrupt is pending
0x14 address — usb2_ep_control address register
  [7:0] address — Controls the current device's USB address. Should be written after a SET_ADDRESS request is received. Automatically resets back to zero on a USB reset.
0x20 ev_status ro — usb2_ep_control ev_status register
  [0] status — usb2_ep_control status register field
0x24 ev_pending — usb2_ep_control ev_pending register
  [0] pending — usb2_ep_control pending register field
0x28 ev_enable — usb2_ep_control ev_enable register
  [0] enable — usb2_ep_control enable register field

## USB2_EP_IN
Base 0xF0005080
0x00 data wo — usb2_ep_in data register
  [7:0] data — Write-only register. Each write enqueues a byte to be transmitted; gradually building a single packet to be transmitted. This queue should only ever contain a single packet; it is the software's responsibility to handle breaking requests down into packets.
0x04 epno — usb2_ep_in epno register
  [3:0] epno — Contains the endpoint the enqueued packet is to be transmitted on. Writing this register marks the relevant packet as ready to transmit; and thus should only be written after a full packet has been written into the FIFO. If no data has been placed into the DATA FIFO, a zero-length packet is generated. Note that any IN requests that do not match the endpoint number are automatically NAK'd.
0x08 reset wo — usb2_ep_in reset register
  [0] reset — A write to this register clears the FIFO without transmitting.
0x0C stall — usb2_ep_in stall register
  [0] stall — When this register contains '1', any IN tokens targeting `epno` will be responded to with a STALL token, rather than DATA or a NAK. For EP0, this register will automatically be cleared when a new SETUP token is received.
0x10 idle ro — usb2_ep_in idle register
  [0] idle — This value is `1` if no packet is actively being transmitted.
0x14 have ro — usb2_ep_in have register
  [0] have — This value is `1` if data is present in the transmit FIFO.
0x18 pend ro — usb2_ep_in pend register
  [0] pend — `1` iff an interrupt is pending
0x1C pid — usb2_ep_in pid register
  [0] pid — Contains the current PID toggle bit for the given endpoint.
0x20 ev_status ro — usb2_ep_in ev_status register
  [0] status — usb2_ep_in status register field
0x24 ev_pending — usb2_ep_in ev_pending register
  [0] pending — usb2_ep_in pending register field
0x28 ev_enable — usb2_ep_in ev_enable register
  [0] enable — usb2_ep_in enable register field

## USB2_EP_OUT
Base 0xF0005100
0x00 data ro — usb2_ep_out data register
  [7:0] data — A FIFO that returns the bytes from the most recently captured OUT transaction. Reading a byte from this register advances the FIFO.
0x04 data_ep ro — usb2_ep_out data_ep register
  [3:0] data_ep — Register that contains the endpoint number associated with the data in the FIFO -- that is, the endpoint number on which the relevant data was received.
0x08 reset wo — usb2_ep_out reset register
  [0] reset — Local reset for the OUT handler; clears the out FIFO.
0x0C epno — usb2_ep_out epno register
  [3:0] epno — Selects the endpoint number to prime. This interface only allows priming a single endpoint at once-- that is, only one endpoint can be ready to receive data at a time. See the `enable` bit for usage.
0x10 enable — usb2_ep_out enable register
  [0] enable — Controls whether any data can be received on any primed OUT endpoint. This bit is automatically cleared on receive in order to give the controller time to read data from the FIFO. It must be re-enabled once the FIFO has been emptied.
0x14 prime wo — usb2_ep_out prime register
  [0] prime — Controls "priming" an out endpoint. To receive data on any endpoint, the CPU must first select the endpoint with the `epno` register; and then write a '1' into the prime and enable register. This prepares our FIFO to receive data; and the next OUT transaction will be captured into the FIFO. When a transaction is complete, the `enable` bit is reset; the `prime` is not. This effectively means that `enable` controls receiving on _any_ of the primed endpoints; while `prime` can be used to build a collection of endpoints willing to participate in receipt. Only one transaction / data packet is captured per `enable` write; repeated enabling is necessary to capture multiple packets.
0x18 stall — usb2_ep_out stall register
  [0] stall — Controls STALL'ing the active endpoint. Setting or clearing this bit will set or clear STALL on the provided endpoint. Endpoint STALLs persist even after `epno` is changed; so multiple endpoints can be stalled at once by writing their respective endpoint numbers into `epno` register and then setting their `stall` bits.
0x1C have ro — usb2_ep_out have register
  [0] have — `1` iff data is available in the FIFO.
0x20 pend ro — usb2_ep_out pend register
  [0] pend — `1` iff an interrupt is pending
0x24 address — usb2_ep_out address register
  [7:0] address — Controls the current device's USB address. Should be written after a SET_ADDRESS request is received. Automatically resets back to zero on a USB reset.
0x28 pid — usb2_ep_out pid register
  [0] pid — Contains the current PID toggle bit for the given endpoint.
0x40 ev_status ro — usb2_ep_out ev_status register
  [0] status — usb2_ep_out status register field
0x44 ev_pending — usb2_ep_out ev_pending register
  [0] pending — usb2_ep_out pending register field
0x48 ev_enable — usb2_ep_out ev_enable register
  [0] enable — usb2_ep_out enable register field
